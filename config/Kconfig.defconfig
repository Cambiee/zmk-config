## config/west.yml
```yaml
manifest:
  remotes:
    - name: halcyonCorsair
      url-base: https://github.com/halcyonCorsair
    # Additional modules containing boards/shields/custom code can be listed here as well
    # See https://docs.zephyrproject.org/3.2.0/develop/west/manifest.html#projects
  projects:
    - name: zmk
      remote: halcyonCorsair
      revision: dumbpad
      import: app/west.yml
  self:
    path: config
```
